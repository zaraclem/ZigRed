#pragma once
// ZigRed PN5180 host transport. SPI mode 0, MSB first, generated by GPIO.
// Reference: NXP PN5180 host interface / AN12650. No Arduino SPI dependency.
#include <Arduino.h>
#include <driver/gpio.h>
class ZigRedPNTransport {
  int nss_,busy_,rst_; unsigned halfUs_;
  static constexpr gpio_num_t sck_=GPIO_NUM_4, mosi_=GPIO_NUM_5, miso_=GPIO_NUM_0;
  static void level(int pin,int value){gpio_set_level(static_cast<gpio_num_t>(pin),value);}
  static int read(int pin){return gpio_get_level(static_cast<gpio_num_t>(pin));}
  bool wait(int expected,const char *stage,uint8_t command) {
    uint32_t start=millis();
    while(read(busy_)!=expected) {
      if(uint32_t(millis()-start)>=250) {
        Serial.printf("PN GPIO timeout: %s cmd=0x%02X BUSY=%d NSS=%d RST=%d\r\n",
          stage,command,read(busy_),read(nss_),read(rst_));
        return false;
      }
      delayMicroseconds(20);
    }
    return true;
  }
public:
  ZigRedPNTransport(int nss,int busy,int rst,unsigned halfUs=2):nss_(nss),busy_(busy),rst_(rst),halfUs_(halfUs){}
  void begin() {
    const int outputs[]={4,5,nss_,rst_};
    for(int pin:outputs){gpio_reset_pin(static_cast<gpio_num_t>(pin));gpio_set_direction(static_cast<gpio_num_t>(pin),GPIO_MODE_OUTPUT);}
    const int inputs[]={0,busy_};
    for(int pin:inputs){gpio_reset_pin(static_cast<gpio_num_t>(pin));gpio_set_direction(static_cast<gpio_num_t>(pin),GPIO_MODE_INPUT);gpio_set_pull_mode(static_cast<gpio_num_t>(pin),GPIO_FLOATING);}
    level(4,0);level(5,0);level(nss_,1);level(rst_,1);
  }
  void reset(){level(nss_,1);level(4,0);level(rst_,0);delay(20);level(rst_,1);delay(50);}
  uint8_t byte(uint8_t data) {
    uint8_t result=0;
    for(int bit=7;bit>=0;--bit) {
      level(5,(data>>bit)&1);delayMicroseconds(halfUs_);
      level(4,1);delayMicroseconds(halfUs_);
      result=static_cast<uint8_t>((result<<1)|read(0));
      level(4,0);
    }
    return result;
  }
  bool exchange(const uint8_t *command,size_t commandSize,uint8_t *response,size_t responseSize,bool strictResponse=false) {
    if(!command||!commandSize||(responseSize&&!response))return false;
    bool ok=false;
    do {
      if(!wait(0,"before command",command[0]))break;
      level(nss_,0);delayMicroseconds(20);
      for(size_t i=0;i<commandSize;++i)byte(command[i]);
      if(!wait(1,"command accepted",command[0]))break;
      level(nss_,1);
      if(!wait(0,"command completed",command[0]))break;
      if(responseSize) {
        delayMicroseconds(20);level(nss_,0);delayMicroseconds(20);
        for(size_t i=0;i<responseSize;++i)response[i]=byte(0xff);
        // BUSY-high wait is optional in normal mode per NXP. Compare the
        // library's strict wait in diagnostics; normal operation releases NSS.
        if(strictResponse&&!wait(1,"response accepted",command[0]))break;
        level(nss_,1);
        if(!wait(0,"response completed",command[0]))break;
      }
      ok=true;
    } while(false);
    level(nss_,1);level(4,0);level(5,0);
    return ok;
  }
};
